## drivers/video/mediatek/Kconfig
```kconfig
# SPDX-License-Identifier: GPL-2.0-only
#
# Copyright (c) 2026 BayLibre, SAS
#
# Author: Julien Stephan <jstephan@baylibre.com>

config VIDEO_MEDIATEK_DISP_COMMON
	bool

config VIDEO_MEDIATEK_VDOSYS0
	bool
	select MISC

config VIDEO_MEDIATEK_HDMI
	bool "Video HDMI Support for Mediatek SoCs"
	depends on VIDEO && ARCH_MEDIATEK
	depends on DM_I2C && PHY && POWER_DOMAIN
	select I2C_EDID
	select MISC
	select VIDEO_MEDIATEK_DISP_COMMON
	select PHY_MTK_HDMI
	select MTK_POWER_DOMAIN
	select SYS_I2C_DDC_MTK
	help
	  Enable support for the HDMI TX output found on recent MediaTek
	  SoCs such as the MT8188. The driver reads the EDID of the
	  connected display, selects its preferred mode and drives the
	  vdosys1 display pipeline (MDP RDMA, padding, merge, ETHDR
	  mixer, DPI) to scan out the U-Boot framebuffer over HDMI.

config VIDEO_MEDIATEK_DSI
	bool "DSI video path for MediaTek SoCs"
	depends on VIDEO && ARCH_MEDIATEK
	select DISPLAY
	select MISC
	select VIDEO_MEDIATEK_DISP_COMMON
	select VIDEO_MEDIATEK_VDOSYS0
	select VIDEO_MIPI_DSI
	help
	  Enable support for the MIPI-DSI display path found on MediaTek
	  SoCs such as the MT8365 and MT8366. The driver drives the vdosys0
	  display pipeline (OVL, RDMA, color, ccorr, AAL, gamma, dither,
	  DSI and MIPI TX PHY) to scan out the U-Boot framebuffer to a DSI
	  panel.
```
